/* Copyright (c) 2015, The Linux Foundation. All rights reserved.
 *
 * This program is free software; you can redistribute it and/or modify
 * it under the terms of the GNU General Public License version 2 and
 * only version 2 as published by the Free Software Foundation.
 *
 * This program is distributed in the hope that it will be useful,
 * but WITHOUT ANY WARRANTY; without even the implied warranty of
 * MERCHANTABILITY or FITNESS FOR A PARTICULAR PURPOSE.  See the
 * GNU General Public License for more details.
 */

/*---------------------------------------------------------------------------
 * This file is autogenerated file using gcdb parser. Please do not edit it.
 * Update input XML file to add a new entry or update variable in this file
 * VERSION = "1.0"
 *---------------------------------------------------------------------------*/
&mdss_mdp {
	dsi_r69007_wqxga_cmd: qcom,mdss_dsi_r69007_wqxga_cmd {
		qcom,mdss-dsi-panel-name = "r69007 command mode dual dsi panel";
		qcom,mdss-dsi-panel-type = "dsi_cmd_mode";
		qcom,mdss-dsi-panel-framerate = <60>;
		qcom,mdss-dsi-virtual-channel-id = <0>;
		qcom,mdss-dsi-stream = <0>;
		qcom,mdss-dsi-panel-width = <720>;
		qcom,mdss-dsi-panel-height = <2560>;
		qcom,mdss-dsi-h-front-porch = <112>;
		qcom,mdss-dsi-h-back-porch = <70>;
		qcom,mdss-dsi-h-pulse-width = <10>;
		qcom,mdss-dsi-h-sync-skew = <0>;
		qcom,mdss-dsi-v-back-porch = <8>;
		qcom,mdss-dsi-v-front-porch = <9>;
		qcom,mdss-dsi-v-pulse-width = <1>;

		qcom,mdss-dsi-h-left-border = <0>;
		qcom,mdss-dsi-h-right-border = <0>;
		qcom,mdss-dsi-v-top-border = <0>;
		qcom,mdss-dsi-v-bottom-border = <0>;
		qcom,mdss-dsi-bpp = <24>;
		qcom,mdss-dsi-color-order = "rgb_swap_rgb";
		qcom,mdss-dsi-underflow-color = <0xff>;
		qcom,mdss-dsi-border-color = <0>;
		qcom,mdss-mdp-transfer-time-us = <12500>;

		qcom,mdss-dsi-panel-color-temperature-command0 = [
			29 01 00 00 00 00 14 C8 01 00 FE EB F0 FC 0F 00 FF F5 F7 F8 0F 00 FE F1 F0 E3 0E
			29 01 00 00 00 00 2C CA 1C FC FC FC 00 00 00 00 00 00 00 00 00 00 00 00 00 00 00 00 00 00 00 00 00 00 00 00 00 00 00 00 00 00 00 00 00 00 00 00 00 00 00
		];

		qcom,mdss-dsi-panel-color-temperature-command1 = [
			29 01 00 00 00 00 14 C8 01 00 FE EB F0 FC 0F 00 FF F5 F8 EE 0F 00 FE F4 F5 BF FF
			29 01 00 00 00 00 2C CA 1C FC FC FC 00 00 00 00 00 00 00 00 00 00 00 00 00 00 00 00 00 00 00 00 00 00 00 00 00 00 00 00 00 00 00 00 00 00 00 00 00 00 00
		];

		qcom,mdss-dsi-panel-color-temperature-command2 = [
			29 01 00 00 00 00 14 C8 01 00 FE EB F0 FC 0F 00 FF F5 F8 E9 0F 00 FE F5 F5 AB FF
			29 01 00 00 00 00 2C CA 1C FC FC FC 00 00 00 00 00 00 00 00 00 00 00 00 00 00 00 00 00 00 00 00 00 00 00 00 00 00 00 00 00 00 00 00 00 00 00 00 00 00 00
		];

		qcom,mdss-dsi-panel-color-temperature-command3 = [
			29 01 00 00 00 00 14 C8 01 00 FE EB F0 FC 0F 00 FF F7 F9 D5 0F 00 FD F6 F5 8A FF
			29 01 00 00 00 00 2C CA 1C FC FC FC 00 00 00 00 00 00 00 00 00 00 00 00 00 00 00 00 00 00 00 00 00 00 00 00 00 00 00 00 00 00 00 00 00 00 00 00 00 00 00
		];

		qcom,mdss-dsi-panel-color-temperature-command4 = [
			29 01 00 00 00 00 14 C8 01 00 FE EB F0 FC 0F 00 FF F7 F9 C9 0F 00 FE F7 F6 6B FE
			29 01 00 00 00 00 2C CA 1C FC FC FC 00 00 00 00 00 00 00 00 00 00 00 00 00 00 00 00 00 00 00 00 00 00 00 00 00 00 00 00 00 00 00 00 00 00 00 00 00 00 00
		];

		qcom,mdss-dsi-panel-color-temperature-command5 = [
			29 01 00 00 00 00 14 C8 01 00 FE EB F0 FC 0F 00 FF F8 FA AF FF 00 FC FA F7 2E FF
			29 01 00 00 00 00 2C CA 1C FC FC FC 00 00 00 00 00 00 00 00 00 00 00 00 00 00 00 00 00 00 00 00 00 00 00 00 00 00 00 00 00 00 00 00 00 00 00 00 00 00 00
		];

		qcom,mdss-dsi-panel-color-temperature-command6 = [
			29 01 00 00 00 00 14 C8 01 00 FE EB F0 FC 0F 00 FF F9 F9 A3 FF 00 FA FB F5 14 FF
			29 01 00 00 00 00 2C CA 1C FC FC FC 00 00 00 00 00 00 00 00 00 00 00 00 00 00 00 00 00 00 00 00 00 00 00 00 00 00 00 00 00 00 00 00 00 00 00 00 00 00 00
		];

		qcom,mdss-dsi-panel-color-temperature-command7 = [
			29 01 00 00 00 00 14 C8 01 00 FE EB F0 FC 0F 00 FE F9 FA 9C FF 00 FB FA F6 00 FF
			29 01 00 00 00 00 2C CA 1D FC FC F7 00 00 00 00 00 00 00 00 00 00 00 FE 00 00 FE 00 00 00 00 00 00 00 00 00 00 00 00 00 00 00 00 00 00 00 00 00 00 00 00
		];

		qcom,mdss-dsi-panel-color-temperature-command8 = [
			29 01 00 00 00 00 14 C8 01 00 FE EB F0 FC 0F 00 FE F9 FA 9C FF 00 FB FA F6 00 FF
			29 01 00 00 00 00 2C CA 1D FC FC F7 00 00 00 00 00 00 00 00 00 00 00 FE 00 00 FE 00 00 00 00 00 00 00 00 00 00 00 00 00 00 00 00 00 00 00 00 00 00 00 00
		];

		qcom,mdss-dsi-panel-color-temperature-command9 = [
			29 01 00 00 00 00 14 C8 01 00 FE EB F0 FC 0F 00 FE F9 FA 9C FF 00 FB FA F6 00 FF
			29 01 00 00 00 00 2C CA 1D FC F2 C0 00 00 00 00 00 00 00 00 00 00 00 F3 00 00 EF 00 FE 00 00 00 00 00 00 00 00 00 00 00 00 00 00 00 00 00 00 00 00 00 00
		];

		qcom,mdss-dsi-panel-color-temperature-command11 = [
			29 01 00 00 00 00 14 C8 01 00 FE EB F0 FC 0F 00 FE F9 FA 9C FF 00 FB FA F6 00 FF
			29 01 00 00 00 00 2C CA 1D FC C8 70 00 00 00 00 00 00 00 00 00 00 00 EB 00 00 DC 00 F2 00 00 00 00 00 00 00 00 00 00 00 00 00 00 00 00 00 00 00 00 00 00
		];

		qcom,mdss-dsi-panel-color-temperature-command12 = [
			29 01 00 00 00 00 14 C8 01 00 FE EB F0 FC 0F 00 FE F9 FA 9C FF 00 FB FA F6 00 FF
			29 01 00 00 00 00 2C CA 1D FC AE 1D 00 00 00 00 00 00 00 00 00 00 00 D8 00 00 C7 00 ED 00 00 00 00 00 00 00 00 00 00 00 00 00 00 00 00 00 00 00 00 00 00
		];

		qcom,mdss-dsi-panel-color-temperature-command13 = [
			29 01 00 00 00 00 14 C8 01 00 FE EB F0 FC 0F 00 FF F9 F8 7F FF 00 FB FA F6 00 0F
			29 01 00 00 00 00 2C CA 1D FC CC 00 00 00 00 00 00 00 00 00 00 00 00 C3 00 00 B0 00 E6 00 FF FF FF FF E6 AE FF 00 00 00 00 00 00 00 00 00 00 00 00 00 00
		];

		qcom,mdss-dsi-panel-color-temperature-command14 = [
			29 01 00 00 00 00 14 C8 01 00 FE EB F0 FC 0F 00 FF F9 F8 7F FF 00 FB FA F6 00 0F
			29 01 00 00 00 00 2C CA 1D FC DD 00 00 00 00 00 00 00 00 00 00 00 00 B2 00 00 9A 00 DE 00 FF FF FF FF DD 99 FF 00 00 00 00 00 00 00 00 00 00 00 00 00 00
		];

		qcom,mdss-dsi-panel-color-temperature-command_restore = [
			29 01 00 00 00 00 14 C8 00 00 00 00 00 FC 00 00 00 00 00 FC 00 00 00 00 00 FC 00
			29 01 00 00 00 00 2C CA 1C FC FC FC 00 00 00 00 00 00 00 00 00 00 00 00 00 00 00 00 00 00 00 00 00 00 00 00 00 00 00 00 00 00 00 00 00 00 00 00 00 00 00
		];

		qcom,mdss-dsi-panel-sre-weak-level = [
			29 01 00 00 00 00 02 B0 04
			39 01 00 00 00 00 02 51 FF
			39 01 00 00 00 00 02 55 F2
			29 01 00 00 00 00 08 B9 6E F1 64 32 00 40 00
			29 01 00 00 00 00 1A CE 65 40 49 53 59 5E 63 68 6E 74 7E 8A 98 A8 BB D0 FF 04 00 04 04 42 00 69 5A
			29 01 00 00 00 00 09 F9 64 7F E0 E6 00 8D BF 80
			29 01 00 00 00 00 03 BD 14 00
			29 01 00 00 00 00 02 B0 00
		];

		qcom,mdss-dsi-panel-sre-middle-level = [
			29 01 00 00 00 00 02 B0 04
			39 01 00 00 00 00 02 51 FF
			39 01 00 00 00 00 02 55 F2
			29 01 00 00 00 00 08 B9 6E F1 64 32 00 40 00
			29 01 00 00 00 00 1A CE 65 40 49 53 59 5E 63 68 6E 74 7E 8A 98 A8 BB D0 FF 04 00 04 04 42 00 69 5A
			29 01 00 00 00 00 09 F9 64 7F E0 E6 00 8D BF 80
			29 01 00 00 00 00 03 BD 64 00
			29 01 00 00 00 00 02 B0 00
		];

		qcom,mdss-dsi-panel-sre-strong-level = [
			29 01 00 00 00 00 02 B0 04
			39 01 00 00 00 00 02 51 FF
			39 01 00 00 00 00 02 55 F2
			29 01 00 00 00 00 08 B9 6E F1 64 32 00 40 00
			29 01 00 00 00 00 1A CE 65 40 49 53 59 5E 63 68 6E 74 7E 8A 98 A8 BB D0 FF 04 00 04 04 42 00 69 5A
			29 01 00 00 00 00 09 F9 64 7F E0 E6 00 8D BF 80
			29 01 00 00 00 00 03 BD FF 00
			29 01 00 00 00 00 02 B0 00
		];

		qcom,mdss-dsi-panel-sre-exit = [
			29 01 00 00 00 00 02 B0 04
			15 01 00 00 00 00 02 55 82
			29 01 00 00 00 00 08 BA CD 51 11 00 17 00 00
			29 01 00 00 00 00 1A CE 65 40 49 53 59 5E 63 68 6E 74 7E 8A 98 A8 BB D0 FF 04 00 04 04 42 00 69 5A
			29 01 00 00 00 00 0A F9 64 FF E0 BE 00 8D BF 80 00
			29 01 00 00 00 00 02 B0 00
		];

		qcom,mdss-dsi-on-command = [
			29 01 00 00 00 00 02 B0 00
			15 01 00 00 00 00 02 35 00
			15 01 00 00 00 00 02 55 82 /* CABC Setting */
			15 01 00 00 00 00 02 5E 20 /* CABC Minimum brightness */
			15 01 00 00 00 00 02 51 FF //LED PWM duty
			15 01 00 00 00 00 02 53 2C
			05 01 00 00 68 00 02 29 00
			05 01 00 00 40 00 02 11 00
		];

		qcom,mdss-dsi-off-command = [
			05 01 00 00 00 00 02 28 00
			05 01 00 00 78 00 02 10 00
		];

		qcom,mdss-dsi-panel-timings-8996 = [
			23 1F 07 09 05 03 04 A0
			23 1F 07 09 05 03 04 A0
			23 1F 07 09 05 03 04 A0
			23 1F 07 09 05 03 04 A0
			23 19 08 08 05 03 04 A0
		];

		qcom,mdss-dsi-on-command-state = "dsi_lp_mode";
		qcom,mdss-dsi-off-command-state = "dsi_hs_mode";
		qcom,mdss-dsi-h-sync-pulse = <1>;
		qcom,mdss-dsi-traffic-mode = "burst_mode";
		qcom,mdss-dsi-lane-map = "lane_map_0123";
		qcom,mdss-dsi-bllp-eof-power-mode;
		qcom,mdss-dsi-bllp-power-mode;
		qcom,dcs-cmd-by-left;
		qcom,mdss-dsi-lane-0-state;
		qcom,mdss-dsi-lane-1-state;
		qcom,mdss-dsi-lane-2-state;
		qcom,mdss-dsi-lane-3-state;
		qcom,mdss-dsi-panel-timings = [da 34 24 00 64 68 28 38 2a 03 04 00];

		qcom,mdss-dsi-t-clk-pre = <0x29>;
		qcom,mdss-dsi-t-clk-post = <0x03>;

		qcom,mdss-dsi-bl-min-level = <1>;
		qcom,mdss-dsi-bl-max-level = <4095>;
		qcom,mdss-dsi-dma-trigger = "trigger_sw";
		qcom,mdss-dsi-mdp-trigger = "none";

		qcom,mdss-dsi-te-pin-select = <1>;
		qcom,mdss-dsi-te-dcs-command = <1>;
		qcom,mdss-dsi-te-check-enable;
		qcom,mdss-dsi-te-using-te-pin;

		qcom,mdss-pan-physical-width-dimension = <71>;
		qcom,mdss-pan-physical-height-dimension = <127>;
		//qcom,esd-check-enabled;
		//qcom,mdss-dsi-panel-status-check-mode = "te_signal_check";
		qcom,mdss-dsi-reset-sequence = <1 1>, <1 1>, <1 5>;
	};
};
